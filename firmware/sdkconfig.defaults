## firmware/sdkconfig.defaults
```kconfig
CONFIG_IDF_TARGET="esp32p4"
CONFIG_ESP32P4_SELECTS_REV_LESS_V3=y
CONFIG_ESP32P4_REV_MIN_100=y
CONFIG_SPIRAM=y
CONFIG_PARTITION_TABLE_CUSTOM=y
CONFIG_PARTITION_TABLE_CUSTOM_FILENAME="partitions.csv"
CONFIG_ESPTOOLPY_FLASHSIZE_32MB=y
CONFIG_ESPTOOLPY_FLASHSIZE="32MB"
CONFIG_MBEDTLS_DYNAMIC_BUFFER=y
CONFIG_ESP_COREDUMP_ENABLE_TO_FLASH=y
CONFIG_ESP_COREDUMP_DATA_FORMAT_ELF=y
CONFIG_LV_USE_CLIB_MALLOC=y
CONFIG_LV_FONT_MONTSERRAT_14=y
CONFIG_LV_FONT_MONTSERRAT_16=y
CONFIG_LV_FONT_MONTSERRAT_28=y

# ESP-Hosted / Wi-Fi Remote baseline for ESP32-P4 + onboard ESP32-C6 over SDIO.
CONFIG_ESP_WIFI_REMOTE_ENABLED=y
CONFIG_ESP_HOSTED_ENABLED=y
CONFIG_ESP_HOST_WIFI_ENABLED=n
CONFIG_ESP_HOSTED_ENABLE_ITWT=n
CONFIG_SLAVE_IDF_TARGET_ESP32C6=y
CONFIG_ESP_HOSTED_CP_TARGET_ESP32C6=y
CONFIG_ESP_HOSTED_P4_DEV_BOARD_FUNC_BOARD=y
CONFIG_WIFI_RMT_STATIC_RX_BUFFER_NUM=10
CONFIG_WIFI_RMT_DYNAMIC_RX_BUFFER_NUM=32
CONFIG_WIFI_RMT_DYNAMIC_TX_BUFFER_NUM=32
CONFIG_WIFI_RMT_AMPDU_TX_ENABLED=y
CONFIG_WIFI_RMT_TX_BA_WIN=32
CONFIG_WIFI_RMT_AMPDU_RX_ENABLED=y
CONFIG_WIFI_RMT_RX_BA_WIN=16
CONFIG_LWIP_TCP_SND_BUF_DEFAULT=11520
CONFIG_LWIP_TCP_WND_DEFAULT=32768
CONFIG_LWIP_TCP_RECVMBOX_SIZE=48
CONFIG_LWIP_UDP_RECVMBOX_SIZE=48
CONFIG_LWIP_TCPIP_RECVMBOX_SIZE=48
CONFIG_LWIP_TCP_SACK_OUT=y
```

## firmware_legacy_reference/experiments/gate15_coexistence/sdkconfig.defaults
```kconfig
# Gate 15 harness - preliminary sdkconfig.
# Target set via `idf.py set-target esp32p4`. Values are starting points; tune
# during Fase 0 against the real board.

# --- PSRAM (required for the framebuffer) ---
# Confirm the exact PSRAM symbols/speed for the purchased P4 board in Fase 0.
CONFIG_SPIRAM=y

# --- Brownout detector: keep ON and log triggers (Gate 16) ---
CONFIG_ESP_BROWNOUT_DET=y

# --- Coredump to flash so silent resets leave evidence (ADR-0014) ---
CONFIG_ESP_COREDUMP_ENABLE_TO_FLASH=y
CONFIG_ESP_COREDUMP_DATA_FORMAT_ELF=y

# --- Stack for the main task (C, modest) ---
CONFIG_ESP_MAIN_TASK_STACK_SIZE=6144

# --- Logging ---
CONFIG_LOG_DEFAULT_LEVEL_INFO=y

# NOTE: Wi-Fi on ESP32-P4 is NOT native. It comes from the ESP32-C6 over
# ESP-Hosted/SDIO. The esp_wifi_remote + esp-hosted managed components (see
# main/idf_component.yml) provide the standard esp_wifi.h API. The exact
# component versions and SDIO pin/clock config MUST be confirmed in Fase 0
# (Gates 8 and 9) before this builds and runs on hardware.

# --- Chip revision (Gate 1 finding, 2026-06-23) ---
# The physical board's ESP32-P4 silicon is revision v1.3 (esptool reports it on
# connect), not the v3.x production revision IDF assumes by default
# (ESP32P4_REV_MIN_301). v0.x/v1.x and v3.x have a documented hardware
# difference (see Kconfig.hw_support) and are mutually exclusive build configs.
# Without this, the bootloader rejects the chip at boot
# ("requires chip revision in range [v3.1 - v3.99]").
CONFIG_ESP32P4_SELECTS_REV_LESS_V3=y
CONFIG_ESP32P4_REV_MIN_100=y

# --- Custom partition table (Gate 3/12 finding, 2026-06-23) ---
# Built-in "singleapp_coredump" template assumes ~1MB factory app; after
# wiring the mbedtls cert bundle (Gate 12) only 4% free space was left.
# Real flash is 32MB, so grow factory/coredump (see partitions.csv).
CONFIG_PARTITION_TABLE_CUSTOM=y
CONFIG_PARTITION_TABLE_CUSTOM_FILENAME="partitions.csv"

# --- Flash size (Gate 3 finding, 2026-06-23) ---
# Boot log: "Detected size(32768k) larger than the size in the binary image
# header(2048k)". The board's real flash chip is 32MB; the default for a new
# esp32p4 sdkconfig is 2MB. Partition table layout (singleapp_coredump) still
# fits fine either way, but declaring the real size avoids the size-mismatch
# warning and any future esptool/OTA size assumption bugs.
CONFIG_ESPTOOLPY_FLASHSIZE_32MB=y
CONFIG_ESPTOOLPY_FLASHSIZE="32MB"
```

## reference/firmware_v3/sdkconfig.defaults
```kconfig
# NovaPanel hardware-first baseline.
# ESP32-P4-WIFI6-Touch-LCD-7B, ESP-IDF 5.5.x.

CONFIG_ESP_MAIN_TASK_STACK_SIZE=8192
CONFIG_ESP_SYSTEM_EVENT_TASK_STACK_SIZE=4096
CONFIG_COMPILER_CXX_RTTI=n
# O TWDT fica habilitado, mas sem autoinscrever Idle Tasks no boot. No ESP32-P4
# com IDF 5.5.4 essa inscricao pode duplicar durante o startup multicore.
# CONFIG_ESP_TASK_WDT_CHECK_IDLE_TASK_CPU0 is not set
# CONFIG_ESP_TASK_WDT_CHECK_IDLE_TASK_CPU1 is not set

# Board flash/PSRAM baseline validated during Phase 0.
CONFIG_IDF_TARGET="esp32p4"
CONFIG_IDF_TARGET_ESP32P4=y
CONFIG_ESPTOOLPY_FLASHSIZE_32MB=y
CONFIG_ESPTOOLPY_FLASHSIZE="32MB"
CONFIG_ESP32P4_SELECTS_REV_LESS_V3=y
CONFIG_ESP32P4_REV_MIN_100=y
CONFIG_SPIRAM=y

# Keep partitions explicit from day one.
CONFIG_PARTITION_TABLE_CUSTOM=y
CONFIG_PARTITION_TABLE_CUSTOM_FILENAME="partitions.csv"
CONFIG_ESP_COREDUMP_ENABLE_TO_FLASH=y

# Display/LVGL baseline (producao): 1 framebuffer + rotacao 180 por PPA.
# avoid_tearing NAO e usado: e incompativel com sw_rotate/PPA neste BSP, e
# este painel EK79007 (DSI video-mode) nao gira por mirror de hardware,
# entao a rotacao 180 precisa do PPA. O flicker observado e do backlight
# (GPIO32), nao tearing.
CONFIG_BSP_LCD_DPI_BUFFER_NUMS=2
# CONFIG_BSP_DISPLAY_LVGL_AVOID_TEAR is not set
# CONFIG_BSP_DISPLAY_LVGL_FULL_REFRESH is not set
# CONFIG_BSP_DISPLAY_LVGL_DIRECT_MODE is not set
# CONFIG_LV_BUILD_EXAMPLES is not set
CONFIG_LV_USE_CLIB_MALLOC=y
CONFIG_LV_FONT_MONTSERRAT_12=y
CONFIG_LV_FONT_MONTSERRAT_14=y
CONFIG_LV_FONT_MONTSERRAT_16=y
CONFIG_LV_FONT_MONTSERRAT_20=y
CONFIG_LV_FONT_MONTSERRAT_24=y
CONFIG_LV_FONT_MONTSERRAT_28=y
CONFIG_LV_FONT_MONTSERRAT_32=y
CONFIG_LV_FONT_MONTSERRAT_48=y

CONFIG_LOG_DEFAULT_LEVEL_INFO=y

# Rede/TLS: libera os buffers grandes do TLS apos o handshake (economia de
# RAM interna). Com as requisicoes serializadas (http_gate em http_client),
# evita a pressao de RAM do boot que abria o circuit breaker dos providers.
CONFIG_MBEDTLS_DYNAMIC_BUFFER=y

# Força mbedTLS a usar SRAM interna para handshakes TLS (fragmentos de 16 KB+).
# Impede que a criptografia HTTPS concorra com o DMA do display na PSRAM.
# Nota: verifique se CONFIG_MBEDTLS_INTERNAL_MEM_ALLOC é o nome correto no
# seu ESP-IDF 5.5.x — alternativa: CONFIG_MBEDTLS_DEFAULT_MEM_ALLOC=y.
CONFIG_MBEDTLS_INTERNAL_MEM_ALLOC=y

# lwIP/TCP-IP: confina o stack de rede ao Core 0 (PRO_CPU).
# Verifique em menuconfig: Component config > LWIP > LWIP task core affinity.
CONFIG_LWIP_TCPIP_TASK_AFFINITY=0x0

# Flash <-> PSRAM dividem o MSPI no ESP32-P4. Um erase/program de flash (NVS
# commit OU gravacao de cache LittleFS depois de cada fetch REST) trava o
# barramento por ms e causa underrun do DMA do MIPI-DSI lendo o framebuffer
# em PSRAM -> flash branco. AUTO_SUSPEND deixa a leitura de cache/PSRAM
# preemptar o erase, mas o flash desta placa e um GD25Q256 (JEDEC C8 4019)
# que NAO esta na lista de chips com suspend validado pela Espressif (boot
# imprime "Suspend and resume may not supported for this flash model yet").
# Como o suspend nao-certificado pode corromper escritas (NVS/cache) em casos
# de borda, fica DESLIGADO. A raiz comum (REST + NVS) e atacada com seguranca
# reduzindo a frequencia de write de flash (throttle do CacheStore + dedup da
# NVS nos services). Reativar so apos um soak de corrupcao no GD25Q256.
# CONFIG_SPI_FLASH_AUTO_SUSPEND is not set
```

## reference/firmware_v3_field_snapshot/experiments/gate15_coexistence/main/Kconfig.projbuild
```kconfig
menu "Gate 15 coexistence harness"

    config GATE15_WIFI_SSID
        string "Wi-Fi SSID for the soak test"
        default ""
        help
            Set via `idf.py menuconfig` and kept only in the local, gitignored
            sdkconfig. Never put real credentials in gate15_main.c or
            sdkconfig.defaults.

    config GATE15_WIFI_PASS
        string "Wi-Fi password for the soak test"
        default ""

endmenu
```

## reference/firmware_v3_field_snapshot/sdkconfig.defaults
```kconfig
# NovaPainel firmware - DEV sdkconfig defaults.
# Used by plain `idf.py build`. Security features (Secure Boot, Flash Encryption,
# NVS Encryption) are intentionally OFF here so flashing/debugging stays frictionless.
# For a PRODUCTION build, apply sdkconfig.prod on top:
#   idf.py -DSDKCONFIG_DEFAULTS="sdkconfig.defaults;sdkconfig.prod" build
# See sdkconfig.prod and ADR-0030 for the full PROD security checklist.

# Target is set via `idf.py set-target esp32p4`.

# Give the main task a comfortable stack for C++ / std::function usage.
# Bumped from 6144 to 16384 (Fase 7 finding): "main" is app_main()'s own
# task - it directly calls ui_dispatcher.process_pending() -> the active
# screen's render()/build(), so every screen's full LVGL widget-tree
# construction runs on THIS task's stack, not just on the BSP's own
# taskLVGL (that one already got bumped to 16384 for the same reason in
# ADR-0025, for a different code path - touch event callbacks). Adding
# SystemScreen (Fase 7) - one more screen's build() on this same call
# path - was enough to exceed the 6144 budget tuned back in Fase 0,
# before CacheStore/ForexService/SystemService/SystemScreen existed:
# "Guru Meditation Error: Core 0 panic'ed (Stack protection fault)...
# Detected in task "main"" on real hardware, confirmed via serial capture.
CONFIG_ESP_MAIN_TASK_STACK_SIZE=16384

# C++: keep RTTI off (smaller). Exceptions left at IDF default (off) - the code
# uses Result<T>/Status instead of throwing.
CONFIG_COMPILER_CXX_RTTI=n

# Flash size: confirmed in Fase 0 (Gate 3) - the real board (Waveshare
# ESP32-P4-WIFI6-Touch-LCD-7B) has 32MB NOR flash, not the 8MB dev-kit
# default. Partition table (factory 3MB + storage 1MB) fits comfortably.
CONFIG_ESPTOOLPY_FLASHSIZE_32MB=y
CONFIG_ESPTOOLPY_FLASHSIZE="32MB"

# Chip revision: confirmed in Fase 0 (Gate 1) - the real board's ESP32-P4
# silicon is revision v1.3, not the v3.x production revision IDF assumes by
# default. v0.x/v1.x and v3.x have a documented hardware difference and are
# mutually exclusive build configs (see esp_hw_support Kconfig.hw_support).
# Without this the bootloader rejects the chip at boot.
CONFIG_ESP32P4_SELECTS_REV_LESS_V3=y
CONFIG_ESP32P4_REV_MIN_100=y

# PSRAM (Gate 4): the real board has 32MB stacked PSRAM, required by the BSP
# for the display's MIPI-DSI framebuffer (Fase 3) - without this,
# bsp_display_new() fails with ESP_ERR_NO_MEM creating the DPI panel.
CONFIG_SPIRAM=y

# Display (blue-flash investigation, 2026-06-26): enable the BSP/esp_lvgl_port
# "avoid tearing" path for the EK79007 MIPI-DSI panel. This makes the LCD
# driver allocate two full-size DPI frame buffers and lets LVGL redraw a full
# frame before the panel swaps buffers, instead of pushing partial dirty
# rectangles into a single live scanout buffer. We prefer FULL_REFRESH over
# DIRECT_MODE here because the observed bug is a brief whole-screen blue flash:
# that pattern matches a stale / partially valid back buffer more than a plain
# tear line, so forcing every swapped buffer to be complete is the safer
# tradeoff while we stabilize the panel path. Rotation stays out of this path
# (`sw_rotate=false` in WaveshareBoard) because the EK79007 driver does not
# support swap_xy().
CONFIG_BSP_LCD_DPI_BUFFER_NUMS=2
CONFIG_BSP_DISPLAY_LVGL_AVOID_TEAR=y
CONFIG_BSP_DISPLAY_LVGL_FULL_REFRESH=y

# Custom partition table (see partitions.csv). Marked preliminary in HARDWARE.md.
CONFIG_PARTITION_TABLE_CUSTOM=y
CONFIG_PARTITION_TABLE_CUSTOM_FILENAME="partitions.csv"

# Coredump to flash (Fase 7, ADR-0014/0028): persists a crash dump to the
# "coredump" partition (partitions.csv) so a panic in the field isn't lost -
# retrievable later via `idf.py coredump-info`. ELF format (IDF default once
# enabled) - no on-device parsing/display, see ADR-0028.
# DEV=on; PROD=off (sdkconfig.prod overrides to n - heap may contain secrets,
# see ADR-0011/0030).
CONFIG_ESP_COREDUMP_ENABLE_TO_FLASH=y

# Default log level INFO.
CONFIG_LOG_DEFAULT_LEVEL_INFO=y

# Keep LVGL's example sources out of the firmware build. They add compile
# time and binary noise without helping the product.
# CONFIG_LV_BUILD_EXAMPLES is not set

# LVGL (Fase 4): font sizes used by HomeScreen, matching the design reference
# in docs/design/lvgl_export_reference/novapanel_theme.h.
CONFIG_LV_FONT_MONTSERRAT_10=y
CONFIG_LV_FONT_MONTSERRAT_12=y
CONFIG_LV_FONT_MONTSERRAT_14=y
CONFIG_LV_FONT_MONTSERRAT_16=y
CONFIG_LV_FONT_MONTSERRAT_20=y
CONFIG_LV_FONT_MONTSERRAT_24=y
CONFIG_LV_FONT_MONTSERRAT_28=y
CONFIG_LV_FONT_MONTSERRAT_32=y
CONFIG_LV_FONT_MONTSERRAT_48=y

# ESP-Hosted SDIO queue size (Fase 4 finding): default 20/20 needs a
# contiguous ~47KB block of MALLOC_CAP_INTERNAL|MALLOC_CAP_DMA memory for
# sdio_mempool_create() (block_size 1536 * (rx_q_size + 11)). This exact
# mitigation is documented upstream in
# espressif__esp_hosted/docs/performance_optimization.md ("Reduce memory
# footprint for resource-constrained applications"). Queue depth is a
# throughput knob (Fase 10), not a correctness requirement now.
CONFIG_ESP_HOSTED_SDIO_TX_Q_SIZE=10
CONFIG_ESP_HOSTED_SDIO_RX_Q_SIZE=10

# LVGL malloc source (Fase 4 root-cause finding): LV_USE_BUILTIN_MALLOC (the
# default) reserves a STATIC 64KB pool (work_mem_int, lv_mem_core_builtin.c)
# in internal RAM, present from boot regardless of actual LVGL usage. This
# alone is most of the ~123KB .bss growth that shrank the early/pre-scheduler
# internal-DMA pool enough to make esp_hosted's own constructor-time SDIO
# init (which runs before app_main, before main_task is even created) fail
# main task creation itself (esp_startup_start_app assert). Switching to the
# standard C malloc/free turns this into on-demand dynamic allocation
# instead of a fixed upfront reservation.
CONFIG_LV_USE_CLIB_MALLOC=y
```
